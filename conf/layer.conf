## conf/layer.conf
```bitbake
# We have a conf and classes directory, add to BBPATH
BBPATH .= ":${LAYERDIR}"

# We have recipes-* directories, add to BBFILES
BBFILES += "${LAYERDIR}/recipes-*/*/*.bb \
            ${LAYERDIR}/recipes-*/*/*.bbappend"

BBFILE_COLLECTIONS += "meta-astrophi"
BBFILE_PATTERN_meta-astrophi = "^${LAYERDIR}/"
BBFILE_PRIORITY_meta-astrophi = "6"

LAYERDEPENDS_meta-astrophi = "core"
LAYERSERIES_COMPAT_meta-astrophi = "kirkstone"
```
